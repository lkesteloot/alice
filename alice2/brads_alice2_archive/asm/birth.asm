LCDINST	EQU	002H
LCDDATA	EQU	003H
STRLEN	EQU	29

START
	LD	HL, STRING
	LD	B, STRLEN
OLOOP
	LD	C, (HL)
	INC	HL
	OUTI
	JR	NZ, OLOOP

	JP	START

STRING
	DB	LCDINST, 38H
	DB	LCDINST, 38H
	DB	LCDINST, 06H
	DB	LCDINST, 0eH
	DB	LCDINST, 01H
	DB	LCDINST, 80H
	DB	LCDDATA, "A"
	DB	LCDDATA, "l"
	DB	LCDDATA, "i"
	DB	LCDDATA, "c"
	DB	LCDDATA, "e"
	DB	LCDDATA, " "
	DB	LCDDATA, "I"
	DB	LCDDATA, "I"
	DB	LCDINST, 0c0H
	DB	LCDDATA, "i"
	DB	LCDDATA, "s"
	DB	LCDDATA, " "
	DB	LCDDATA, "a"
	DB	LCDDATA, "l"
	DB	LCDDATA, "i"
	DB	LCDDATA, "v"
	DB	LCDDATA, "e"
	DB	LCDINST, 0c0H
	DB	LCDINST, 0c0H
	DB	LCDINST, 0c0H
	DB	LCDINST, 0c0H
	DB	LCDINST, 0c0H
	DB	LCDINST, 0c0H

	END
