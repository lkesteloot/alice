LCDINST	EQU	002H		; LCD instruction I/O address
LCDDATA	EQU	003H		; LCD data I/O address
LCLEAR	EQU	001H		; LCD clear instruction
LRESET	EQU	038H		; LCD reset to normal instruction
LHALF1	EQU	080H		; LCD move cursor to char 1
LHALF2	EQU	0c0H		; LCD move cursor to char 9

;
; Main program
;
START
	LD	IX, LOOP
	JP	LCDINIT
LOOP
	LD	HL, STRING
	LD	B, STRLEN
	LD	IX, RET1
	JP 	LOUTLOOP
RET1
	JP	LOOP

;
; LCD Init routine
;
LCDINIT
	LD	HL, LISTRING
	LD	B, LISTRLEN	; falls through into string output

;
; LCD string bytes output routine
;
LOUTLOOP
	LD	C, (HL)
	INC	HL
	OUTI
	JR	NZ, LOUTLOOP

	JP	(IX)

;
; LCD Initialization string
;
LISTRLEN	EQU	14
LISTRING
	DB	LCDINST, LRESET
	DB	LCDINST, LRESET
	DB	LCDINST, 006H
	DB	LCDINST, 00eH
	DB	LCDINST, LCLEAR
	DB	LCDINST, LHALF1
	DB	LCDINST, LHALF1
	DB	LCDINST, LHALF1
	DB	LCDINST, LHALF1
	DB	LCDINST, LHALF1
	DB	LCDINST, LHALF1
	DB	LCDINST, LHALF1
	DB	LCDINST, LHALF1
	DB	LCDINST, LHALF1

;
; Our string
;
STRLEN		EQU	59
STRING
	DB	LCDDATA, "A"
	DB	LCDDATA, "l"
	DB	LCDDATA, "i"
	DB	LCDDATA, "c"
	DB	LCDDATA, "e"
	DB	LCDDATA, " "
	DB	LCDDATA, "2"
	DB	LCDDATA, " "
	DB	LCDINST, LHALF2
	DB	LCDDATA, "i"
	DB	LCDDATA, "s"
	DB	LCDDATA, " "
	DB	LCDDATA, "a"
	DB	LCDDATA, "l"
	DB	LCDDATA, "i"
	DB	LCDDATA, "v"
	DB	LCDDATA, "e"
	DB	LCDINST, LHALF1
	DB	LCDINST, LHALF1
	DB	LCDINST, LHALF1
	DB	LCDINST, LHALF1
	DB	LCDINST, LHALF1
	DB	LCDINST, LCLEAR
	DB	LCDDATA, "B"
	DB	LCDDATA, "r"
	DB	LCDDATA, "a"
	DB	LCDDATA, "d"
	DB	LCDDATA, " "
	DB	LCDDATA, 26H
	DB	LCDDATA, " "
	DB	LCDDATA, "L"
	DB	LCDINST, LHALF2
	DB	LCDDATA, "a"
	DB	LCDDATA, "w"
	DB	LCDDATA, "r"
	DB	LCDDATA, "e"
	DB	LCDDATA, "n"
	DB	LCDDATA, "c"
	DB	LCDDATA, "e"
	DB	LCDDATA, " "
	DB	LCDINST, LHALF1
	DB	LCDINST, LHALF1
	DB	LCDINST, LCLEAR
	DB	LCDDATA, " "
	DB	LCDDATA, "a"
	DB	LCDDATA, "r"
	DB	LCDDATA, "e"
	DB	LCDDATA, " "
	DB	LCDDATA, "c"
	DB	LCDDATA, "o"
	DB	LCDDATA, "o"
	DB	LCDINST, LHALF2
	DB	LCDDATA, "l"
	DB	LCDDATA, "."
	DB	LCDINST, LHALF1
	DB	LCDINST, LHALF1
	DB	LCDINST, LHALF1
	DB	LCDINST, LHALF1
	DB	LCDINST, LHALF1


	END
